// T32 Tue Sep 14 22:02:27 2010

 B::
 
 BREAK.RESET
 BREAK.SELECT PROGRAM ONCHIP
 BREAK.SELECT READ ONCHIP
 BREAK.SELECT WRITE ONCHIP
 B.S   BOOTROM_RAMLoader /P
 B.S   BOOT_Fail /P /DISABLE
 
 ENDDO

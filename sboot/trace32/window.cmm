// T32 Fri Feb 03 15:58:41 2012

 B::
 
 TOOLBAR ON
 STATUSBAR ON
 WINPAGE.RESET
 
 WINCLEAR
 WINPOS 99.5 0.57143 51. 18. 0. 0. W000
 SYStem
 
 WINPOS 75.375 28.786 80. 6. 23. 1. W003
 WINTABS 13. 0. 0. 0. 0. 0. 0.
 Break.List
 
 WINPOS 123.25 0.071429 32. 27. 0. 0. W001
 Register
 
 WINPAGE.SELECT P000     
 
 ENDDO

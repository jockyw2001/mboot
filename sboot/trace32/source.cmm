// T32 Wed Nov 04 16:14:41 2009

 B::
 
 SYMBOL.SPATH.RESET
 
 ENDDO
